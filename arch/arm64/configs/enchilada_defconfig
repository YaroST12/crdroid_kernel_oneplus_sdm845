## drivers/oneplus/Kconfig
```kconfig
source "drivers/oneplus/coretech/Kconfig"
source "drivers/oneplus/drivers/Kconfig"
source "drivers/oneplus/fs/Kconfig"
source "drivers/oneplus/tri_state_key/Kconfig"
```
